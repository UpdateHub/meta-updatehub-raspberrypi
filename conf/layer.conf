## conf/layer.conf
```bitbake
# We have a conf and classes directory, add to BBPATH
BBPATH .= ":${LAYERDIR}"

# We have recipes-* directories, add to BBFILES
BBFILES += "${LAYERDIR}/recipes-*/*/*.bb \
	${LAYERDIR}/recipes-*/*/*.bbappend"

BBFILE_COLLECTIONS += "updatehub-raspberrypi"
BBFILE_PATTERN_updatehub-raspberrypi = "^${LAYERDIR}/"
BBFILE_PRIORITY_updatehub-raspberrypi = "6"

LAYERSERIES_COMPAT_updatehub-raspberrypi = "honister"
LAYERDEPENDS_updatehub-raspberrypi = "updatehub raspberrypi"

###
# Global setting to use UpadateHub with meta-rasberrypi layer
#
# Setting to use wic image
WKS_FILE_DEPENDS:updatehub-rpi += "virtual/bootloader"
IMAGE_FSTYPES:updatehub-rpi ??= "ext4.xz wic.bmap wic.gz"
WKS_FILES:updatehub-rpi ??= "${MACHINE}.wks updatehub.rpi.wks"
WKS_SEARCH_PATH:updatehub-rpi ??= "${THISDIR}:${@':'.join('%s/wic' % p for p in '${BBPATH}'.split(':'))}:${@':'.join('%s/scripts/lib/wic/canned-wks' % l for l in '${BBPATH}:${COREBASE}'.split(':'))}"

# UpdateHub settings
UPDATEHUB_ACTIVE_INACTIVE_BACKEND:updatehub-rpi ??= "u-boot"
UPDATEHUB_DEVICE_IDENTITY:updatehub-rpi ??= "cpuinfo-serial"
UPDATEHUB_FILESYSTEM_SUPPORT:updatehub-rpi ??= "vfat ext4"
UPDATEHUB_IMAGE_TYPE:updatehub-rpi ??= "active/inactive"
UPDATEHUB_INSTALL_MODE:updatehub-rpi ??= "copy raw"

PREFERRED_PROVIDER_u-boot-fw-utils:updatehub-rpi ??= "libubootenv"
PREFERRED_PROVIDER_u-boot:updatehub-rpi ??= "u-boot"
PREFERRED_PROVIDER_virtual/bootloader:updatehub-rpi ??= "u-boot"
PREFERRED_PROVIDER_u-boot-tools-native ??= "u-boot-tools-native"
PREFERRED_PROVIDER_u-boot-mkimage-native ??= "u-boot-tools-native"
PREFERRED_PROVIDER_u-boot-mkimage ??= "u-boot-tools"
PREFERRED_PROVIDER_nativesdk-u-boot-mkimage ??= "nativesdk-u-boot-tools"
PREFERRED_PROVIDER_u-boot-default-script:updatehub-rpi ??= "u-boot-updatehub-script"
UPDATEHUB_RUNTIME_PACKAGES:append:updatehub-rpi = " u-boot-default-script u-boot-default-env"
RPI_USE_U_BOOT:updatehub-rpi = "1"
MACHINE_ESSENTIAL_EXTRA_RDEPENDS:updatehub-rpi += " \
    kernel-image \
    kernel-devicetree \
"

# Do not change fstab file
WIC_CREATE_EXTRA_ARGS:updatehub-rpi ??= "--no-fstab-update"

# UpdateHub Bootscript variables for raspberrypi3/64 and raspberrypi4/64 machine
UPDATEHUB_BOOTSCRIPT_LOAD_A:updatehub-rpi ??= "\
load mmc \${devnum}:2 \${kernel_addr_r} /boot/${KERNEL_IMAGETYPE}; fdt addr \${fdt_addr}; \
fdt get value bootargs_dtb /chosen bootargs \
"
UPDATEHUB_BOOTSCRIPT_LOAD_B:updatehub-rpi ??= "\
load mmc \${devnum}:3 \${kernel_addr_r} /boot/${KERNEL_IMAGETYPE}; fdt addr \${fdt_addr}; \
fdt get value bootargs_dtb /chosen bootargs \
"
UPDATEHUB_BOOTSCRIPT_FIND_ROOT_A:updatehub-rpi ??= "part uuid mmc \${devnum}:2 uuid"
UPDATEHUB_BOOTSCRIPT_FIND_ROOT_B:updatehub-rpi ??= "part uuid mmc \${devnum}:3 uuid"
UPDATEHUB_BOOTSCRIPT_BOOTARGS:updatehub-rpi ??= "\${bootargs_dtb} root=PARTUUID=\${uuid} rw kgdboc=serial0"
UPDATEHUB_BOOTSCRIPT_BOOTCMD:updatehub-rpi ??= "${KERNEL_BOOTCMD} \${kernel_addr_r} - \${fdt_addr}"

###
# Configuration for Raspberry Pi Devices
#
# UpdateHub settings for raspberrypi3 machine
MACHINEOVERRIDES:prepend:raspberrypi3 = "updatehub-rpi:"

###
# Configuration for Raspberry Pi Devices
#
# UpdateHub settings for raspberrypi3-64 machine
MACHINEOVERRIDES:prepend:raspberrypi3-64 = "updatehub-rpi:"

KERNEL_IMAGETYPE_UBOOT:updatehub-rpi:raspberrypi3-64 ??= "Image"

###
# Configuration for Raspberry Pi Devices
#
# UpdateHub settings for raspberrypi4 machine
MACHINEOVERRIDES:prepend:raspberrypi4 = "updatehub-rpi:"

###
# Configuration for Raspberry Pi Devices
#
# UpdateHub settings for raspberrypi4-64 machine
MACHINEOVERRIDES:prepend:raspberrypi4-64 = "updatehub-rpi:"

KERNEL_IMAGETYPE_UBOOT:updatehub-rpi:raspberrypi4-64 ??= "Image"

###
# Configuration for Raspberry Pi Devices
#
# UpdateHub settings for raspberrypi0-wifi machine
MACHINEOVERRIDES:prepend:raspberrypi0-wifi = "updatehub-rpi:"
```

## wic/updatehub.rpi.wks
```
part /boot --source bootimg-partition --ondisk mmcblk --fstype=vfat --label boot --active --align 4096 --size 20
part / --source rootfs --ondisk mmcblk --fstype=ext4 --label system_a  --align 8192 --extra-space 200
part / --source rootfs --ondisk mmcblk --fstype=ext4 --label system_b  --align 8192 --extra-space 200

part /data --ondisk mmcblk --fstype=ext4 --label data --size 16M --align 8192 --extra-space 0

bootloader --ptable msdos
```
